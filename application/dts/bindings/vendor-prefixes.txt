## west.yml
```yaml
manifest:
  self:
    path: .

  remotes:
    - name: ncs
      url-base: https://github.com/nrfconnect

  projects:
    - name: sdk-nrf
      remote: ncs
      revision: v3.2.1
      path: nrf
      import: true
```
